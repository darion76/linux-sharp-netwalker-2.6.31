## drivers/net/wireless/ks7010_sdio/Kconfig
```kconfig
config KS7010_SDIO
	tristate "Driver for KeyStream 11b/g wireless LAN cards."
	depends on WIRELESS
	---help---
	  This module adds support for wireless adapters based on
	  KeyStream 7010 chipset.
```

## drivers/staging/rt2870/Kconfig
```kconfig
config RT2870
	tristate "Ralink 2870/3070 wireless support"
	depends on USB && WLAN_80211
	---help---
	  This is an experimental driver for the Ralink xx70 wireless chips.
```

## drivers/staging/rt3070/Kconfig
```kconfig
config RT3070
	tristate "Ralink 3070 wireless support"
	depends on USB && WLAN_80211
	---help---
	  This is an experimental driver for the Ralink 3070 wireless chip.
```
